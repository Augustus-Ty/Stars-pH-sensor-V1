/* Stars pH sensor
   Coded by: Augusto Zeballos
             2024
*/
//Librerias
     #include <Wire.h>
     #include <Adafruit_GFX.h>
     #include <Adafruit_SSD1306.h>
     #include <WiFi.h> 
     #include "WiFiClientSecure.h"
     #include "Adafruit_MQTT.h"
     #include "Adafruit_MQTT_Client.h"
//Fin de Librerias
/************************* WiFi Access Point *********************************/
     #define WLAN_SSID       "SENSORPHWIFI"  // Ingresa el nombre de tu red         
     #define WLAN_PASS       "No"  // Ingresa la contraseña de tu red 
/************************* Adafruit.io Setup *********************************/
#define AIO_SERVER "io.adafruit.com"
// Using port 8883 for MQTTS
#define AIO_SERVERPORT 8883
// Adafruit IO Account Configuration
#define AIO_USERNAME  "-W-W-W-"
#define AIO_KEY       "nop"
/************ Global State (you don't need to change this!) ******************/
// WiFiFlientSecure for SSL/TLS support
WiFiClientSecure client;
// Setup the MQTT client class by passing in the WiFi client and MQTT server and login details.
Adafruit_MQTT_Client mqtt(&client, AIO_SERVER, AIO_SERVERPORT, AIO_USERNAME, AIO_KEY);
// io.adafruit.com root CA
const char* adafruitio_root_ca = \
      "-----BEGIN CERTIFICATE-----\n"
      "MIIEjTCCA3WgAwIBAgIQDQd4KhM/xvmlcpbhMf/ReTANBgkqhkiG9w0BAQsFADBh\n"
      "MQswCQYDVQofcoursenotarealcertificateMRkwFwYDVQQLExB3\n"
      "d3cuZGlnaWNlcnQuY29tMSAwHgYDVQQDExdEaWdpQ2VydCBHbG9iYWwgUm9vdCBH\n"
      "MjAeFw0xNzExMDIxMjIzMzdaFw0yNzExMDIxMjIzMzdaMGAxCzAJBgNVBAYTAlVT\n"
      "MRUwEwYDVQQofcoursenotarealcertificatey5kaWdpY2VydC5j\n"
      "b2Q0EgRzEwggEiMA0GCSqGSIb3\n"
      "DQEofcoursenotarealcertificateDIuWegh1Ngwvm4Q\n"
      "yISgP7oU5d79eoySG3vOhC3w/3jEMuipoH1fBtp7m0tTpsYbAhch4XA7rfuD6whU\n"
      "gajeErofcoursenotarealcertificateYXcbTVN5SATYq\n"
      "DfofcoursenotarealcertificateZhsDS\n"
      "7h4SeM6Y8l/7MBRpPCz6l8Y=\n"
      "-----END CERTIFICATE-----\n";


/****************************** Feeds ***************************************/

Adafruit_MQTT_Publish WifipH = Adafruit_MQTT_Publish(&mqtt, AIO_USERNAME "/feeds/pH_Valor");
//Configuracion de pantalla y sensor
#define SensorPin 34        
unsigned long int avgValue;  
float b;
int buf[10],temp;
float phValue=0;
#define SCREEN_WIDTH 128  // OLED display width, in pixels
#define SCREEN_HEIGHT 64  // OLED display height, in pixels
#define OLED_RESET    -1  
Adafruit_SSD1306 display(SCREEN_WIDTH, SCREEN_HEIGHT, &Wire, OLED_RESET);
//Fin configuracion de pantalla y sensor
//Configuracion de los dobles nucleos
TaskHandle_t TareaWiFi;
//Fin de la configuracion de los dobles nucleos 
//Bitmap del logo
const unsigned char LOGO [] PROGMEM = {
	0x00, 0x00, 0x00, 0x00, 0x00, 0x00, 0x00, 0x00, 0x00, 0x00, 0x00, 0x00, 0x00, 0x00, 0x00, 0x00, 
	0x00, 0x00, 0x00, 0x00, 0x00, 0x00, 0x00, 0x00, 0x00, 0x00, 0x00, 0x00, 0x00, 0x00, 0x00, 0x00, 
	0x00, 0x00, 0x00, 0x00, 0x00, 0x00, 0x00, 0x00, 0x00, 0x00, 0x00, 0x00, 0x00, 0x00, 0x00, 0x00, 
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	0x00, 0x00, 0x00, 0x00, 0x00, 0x00, 0x00, 0x00, 0x00, 0x00, 0x00, 0x00, 0x00, 0x00, 0x00, 0x00
};
const unsigned char stars [] PROGMEM = {
	0x00, 0x00, 0x00, 0x00, 0x00, 0x00, 0x00, 0x00, 0x00, 0x00, 0x00, 0x00, 0x00, 0x00, 0x00, 0x00, 
	0x00, 0x00, 0x00, 0x00, 0x00, 0x00, 0x00, 0x00, 0x00, 0x00, 0x00, 0x00, 0x00, 0x00, 0x00, 0x00, 
	0x00, 0x00, 0x00, 0x00, 0x00, 0x00, 0x00, 0x00, 0x00, 0x00, 0x00, 0x00, 0x00, 0x00, 0x00, 0x00, 
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	0x00, 0x00, 0x00, 0x00, 0x00, 0x00, 0x00, 0x00, 0x00, 0x00, 0x00, 0x00, 0x00, 0x00, 0x00, 0x00
};

void setup() {
  Serial.begin(115200);
  delay(10);

  Serial.println(F("Adafruit IO MQTTS (SSL/TLS) Example"));

  // Connect to WiFi access point.
  Serial.println();
  Serial.println();
  Serial.print("Connecting to ");
  Serial.println(WLAN_SSID);

  delay(1000);

  WiFi.begin(WLAN_SSID, WLAN_PASS);
  delay(2000);

  while (WiFi.status() != WL_CONNECTED) {
    delay(500);
    Serial.print(".");
  }
  Serial.println();
  Serial.println("WiFi connected");
  Serial.println("IP address: ");
  Serial.println(WiFi.localIP());
  client.setCACert(adafruitio_root_ca);
   //Configuracion Pantalla
     if(!display.begin(SSD1306_SWITCHCAPVCC, 0x3C)) 
     { 
      Serial.println(F("SSD1306 allocation failed"));
      for(;;);
     }
     display.display();
     display.clearDisplay();
     delay(2);
     display.clearDisplay();
     display.setTextColor(WHITE);
     display.setTextSize(1);
     display.setCursor(0,5);
     display.print(".");
     display.display();
     delay(10);
     display.clearDisplay();
     display.drawBitmap(0, 0, LOGO, 128, 64, WHITE);
     display.display();
     delay(4000);
     display.clearDisplay();
     display.drawBitmap(0, 0, stars, 128, 64, WHITE);
     display.display();
     delay(4000);
  //Fin de configuracion Pantalla
  //Configuracion del segundo nucleo
   xTaskCreatePinnedToCore(
    TaskWiFicode, /* Task function. */
    "TareaWiFi", /* name of task. */
    10000, /* Stack size of task */
    NULL, /* parameter of the task */
    1, /* priority of the task */
    &TareaWiFi, // Task handle to keep track of created task 
    0    /* pin task to core 0 */ 
  ); 
  delay(500);
  //Fin de la configuracion WiFi
}
//Inicio de void loop core 1
void loop()
{
  for(int i=0;i<10;i++)       //Get 10 sample value from the sensor for smooth the value
  { 
    buf[i]=analogRead(SensorPin);
    delay(10);
  }
  for(int i=0;i<9;i++)        //sort the analog from small to large
  {
    for(int j=i+1;j<10;j++)
    {
      if(buf[i]>buf[j])
      {
        temp=buf[i];
        buf[i]=buf[j];
        buf[j]=temp;
      }
    }
  }
  avgValue=0;
  for(int i=3;i<7;i++)                      //take the average value and exclude the outliers values
    avgValue+=buf[i];
  phValue=(float)avgValue*3.3/4095/4; //convert the analog into millivolt
  phValue=4.2*phValue;                      //convert the millivolt into pH value
  Serial.print("    pH:");  
  Serial.print(phValue,2);
  Serial.println(" ");
  
  display.clearDisplay();
  display.setTextSize(2);
  display.setCursor(20,0);
  display.println("pH:");
 
  display.setTextSize(3);
  display.setCursor(30,30);
  display.print(phValue);
 
  display.display(); 
    
  delay(800);
 
}//Fin del void loop core 1

//Inicio de la tarea WiFi
void TaskWiFicode( void * pvParameters ){
  while (1){
  MQTT_connect();
  indicatorPublish();
  delay(2000);
  } 
}//Fin de la tarea WiFi




void indicatorPublish() {

  float WifipHe = phValue;
  if (!WifipH.publish(WifipHe)) {
    Serial.println(F("Failed"));
  } else {
    Serial.print("pH: ");
    Serial.println(WifipHe);
  }
}

void MQTT_connect() {
  int8_t ret;
  // Stop if already connected.
  if (mqtt.connected()) {
    return;
  }
  Serial.print("Connecting to MQTT... ");
  uint8_t retries = 3;
  while ((ret = mqtt.connect()) != 0) {  // connect will return 0 for connected
    Serial.println(mqtt.connectErrorString(ret));
    Serial.println("Retrying MQTT connection in 5 seconds...");
    mqtt.disconnect();
    delay(5000);  // wait 5 seconds
    retries--;
    if (retries == 0) {
      while (1)
        ;
    }
  }
  Serial.println("MQTT Connected!");
}